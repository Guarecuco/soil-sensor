/*
 * Copyright (c) 2018, Texas Instruments Incorporated
 * All rights reserved.
 *
 * Redistribution and use in source and binary forms, with or without
 * modification, are permitted provided that the following conditions
 * are met:
 *
 * *  Redistributions of source code must retain the above copyright
 *    notice, this list of conditions and the following disclaimer.
 *
 * *  Redistributions in binary form must reproduce the above copyright
 *    notice, this list of conditions and the following disclaimer in the
 *    documentation and/or other materials provided with the distribution.
 *
 * *  Neither the name of Texas Instruments Incorporated nor the names of
 *    its contributors may be used to endorse or promote products derived
 *    from this software without specific prior written permission.
 *
 * THIS SOFTWARE IS PROVIDED BY THE COPYRIGHT HOLDERS AND CONTRIBUTORS "AS IS"
 * AND ANY EXPRESS OR IMPLIED WARRANTIES, INCLUDING, BUT NOT LIMITED TO,
 * THE IMPLIED WARRANTIES OF MERCHANTABILITY AND FITNESS FOR A PARTICULAR
 * PURPOSE ARE DISCLAIMED. IN NO EVENT SHALL THE COPYRIGHT OWNER OR
 * CONTRIBUTORS BE LIABLE FOR ANY DIRECT, INDIRECT, INCIDENTAL, SPECIAL,
 * EXEMPLARY, OR CONSEQUENTIAL DAMAGES (INCLUDING, BUT NOT LIMITED TO,
 * PROCUREMENT OF SUBSTITUTE GOODS OR SERVICES; LOSS OF USE, DATA, OR PROFITS;
 * OR BUSINESS INTERRUPTION) HOWEVER CAUSED AND ON ANY THEORY OF LIABILITY,
 * WHETHER IN CONTRACT, STRICT LIABILITY, OR TORT (INCLUDING NEGLIGENCE OR
 * OTHERWISE) ARISING IN ANY WAY OUT OF THE USE OF THIS SOFTWARE,
 * EVEN IF ADVISED OF THE POSSIBILITY OF SUCH DAMAGE.
 */
// @cliArgs --board /ti/boards/LP_EM_CC2340R53 --rtos freertos

/*
 *  basic_ble.syscfg
 */

/* ======== Example Configuration ======== */
const lpName = system.getScript("/ti/ble/ble_common.js").getLaunchPadName();
var needsDisplay = true;
var needsButtons = false; // unused - nothing in this project reads CONFIG_BUTTON_0/1
var needsLeds = false; // unused - nothing in this project drives CONFIG_GPIO_LED_RED/GREEN
var needsNvs = true;
var needsOad = false;
var heapSize = 0x00004D50;
var timerStackSize = 0x00000190;
var idleStackSize = 0x00000130;

/* ======== BLE ======== */
var ble = scripting.addModule("/ti/ble/ble");
ble.deviceRole = "PERIPHERAL_CFG";
// Stable public address instead of a rotating private one: this is a
// stationary sensor, not something that needs BLE address privacy, and a
// changing address would fragment the Android app's per-device history
// (it keys stored readings by BLE address).
ble.addressMode = "ADDRMODE_PUBLIC";
ble.basicBLE = true;
ble.disDevBySerUuid = true;
ble.maxConnNum = 1;
ble.deviceName = "SoilSensor";
ble.numOfAdvSets = 1;
// Gap Advertising Flags
ble.advSet1.advData1.GAP_ADTYPE_FLAGS = true;
ble.advSet1.advData1.advertisingFlags = ["GAP_ADTYPE_FLAGS_BREDR_NOT_SUPPORTED","GAP_ADTYPE_FLAGS_GENERAL"];
// Advertise the custom Soil Sensor service's 128-bit UUID so phones can
// filter scans on it instead of matching by device name
ble.advSet1.advData1.GAP_ADTYPE_128BIT_MORE = true;
ble.advSet1.advData1.numOfUUIDs128More = 1;
ble.advSet1.advData1.UUID0128More = system.utils.bigInt("00000000000000b00040510400aa00f0", 16);
// Complete local name
ble.advSet1.scanRes1.GAP_ADTYPE_LOCAL_NAME_COMPLETE = true;
const connIntervalRange = system.getScript("/ti/ble/ble_common.js").getPeripheralConnIntervalRange();
ble.advSet1.scanRes1[connIntervalRange] = true;
// Min Connection Interval
ble.advSet1.scanRes1.minConnInterval = 100;
// Max Connection Interval
ble.advSet1.scanRes1.maxConnInterval = 130;
// TX Power Level
ble.advSet1.scanRes1.GAP_ADTYPE_POWER_LEVEL = true;

/* ======== RCL ======== */
const RCL = scripting.addModule("/ti/drivers/RCL");
if (typeof rclPbeGpoMask !== 'undefined')
{
    RCL.pbeGpoMask = rclPbeGpoMask;
}
if (typeof rclUseCase !== 'undefined')
{
    RCL.useCase = rclUseCase;
}
if (typeof rclSignals !== 'undefined')
{
    RCL.signals = rclSignals;

    if (typeof pbegpo2Pin !== 'undefined' && typeof pbegpo3Pin !== 'undefined')
    {
        RCL.lrfGpio.pbegpo2Pin.$assign = pbegpo2Pin;
        RCL.lrfGpio.pbegpo3Pin.$assign = pbegpo3Pin;
    }
}

/* ======== POWER ======== */
var Power = scripting.addModule("/ti/drivers/Power");
if (typeof needsPowerWfi !== 'undefined' && needsPowerWfi)
{
    if (lpName.match(/CC27\d\d/))
    {
        Power.policyFunction = "PowerCC27XX_doWFI";
    }
    else if (lpName.match(/CC23\d\d/))
    {
        Power.policyFunction = "PowerCC23X0_doWFI";
    }
}

/* ======== RNG ======== */
var RNG = scripting.addModule("/ti/drivers/RNG");
RNG.rngReturnBehavior = "RNG_RETURN_BEHAVIOR_BLOCKING";

/* ======== RF Design ======== */
var rfDesign = scripting.addModule("ti/devices/radioconfig/rfdesign");
const rfDesignSettings = system.getScript("/ti/common/lprf_rf_design_settings.js").rfDesignSettings;
for(var setting in rfDesignSettings)
{
    rfDesign[setting] = rfDesignSettings[setting];
}

/* ======== Device ======== */
var device = scripting.addModule("ti/devices/CCFG");
const ccfgSettings = system.getScript("/ti/common/lprf_ccfg_settings.js").ccfgSettings;
for(var setting in ccfgSettings)
{
    device[setting] = ccfgSettings[setting];
}

/* ======== FreeRTOS ======== */
const FreeRTOS = scripting.addModule("/freertos/FreeRTOS");
const Settings = scripting.addModule("/ti/posix/freertos/Settings");
const bleCommon = system.getScript("/ti/ble/.meta/ble_common.js");

FreeRTOS.heapSize = heapSize;
FreeRTOS.maxPriorities = 10;

// configure Timer task priority = maxPriorities - 1 - same level as Stack priority
bleCommon.configureTimerTaskPriority(FreeRTOS); 

if (lpName.match(/CC27\d\d/))
{
    FreeRTOS.heapSize = 0x00010000;
}
if (lpName == "LP_EM_CC2340R53")
{
    FreeRTOS.heapSize = 0x0000A000;
}
FreeRTOS.timerStackSize = timerStackSize;
FreeRTOS.idleStackSize = idleStackSize;

/* ======== NVS ======== */
var NVS = scripting.addModule("/ti/drivers/NVS");
if (needsNvs)
{
    var nvs = NVS.addInstance();
    nvs.internalFlash.regionBase = system.getScript("/ti/ble/ble_common.js").getBondNVBaseAddress();
    nvs.internalFlash.regionSize = 0x3000;
    nvs.$name = "CONFIG_NVSINTERNAL";
}

/* ======== I2C (seesaw soil sensor) ======== */
var I2C = scripting.addModule("/ti/drivers/I2C");
var i2c = I2C.addInstance();
i2c.$name = "CONFIG_I2C_0";

/* ======== Display (conditional) ======== */
if (needsDisplay)
{
    var Display = scripting.addModule("/ti/display/Display");
    var displayUART = Display.addInstance();
    displayUART.$hardware = system.deviceData.board.components.XDS110UART;
    displayUART.enableANSI = true;
    displayUART.uartBufferSize = 128;
    displayUART.uart.txPinInstance.outputState = "High";
    displayUART.uart.$name = "CONFIG_UART2_0";
    displayUART.uart.txPinInstance.$name = "CONFIG_PIN_UART_TX";
}

/* ======== UART for NPI (conditional) ======== */
if (typeof needsUartNpi !== 'undefined' && needsUartNpi)
{
    var UART = scripting.addModule("/ti/drivers/UART2", {}, false);
    var UART1 = UART.addInstance();
    UART1.$hardware = system.deviceData.board.components.XDS110UART;
    UART1.txPinInstance.initialOutputState = "High";
    UART1.$name = "CONFIG_UART2_0";
    ble.disableDisplayModule = true;
}

/* ======== Buttons (conditional) ======== */
if (needsButtons)
{
    const Button = scripting.addModule("/ti/drivers/apps/Button", {}, false);
    const Button1 = Button.addInstance();
    const Button2 = Button.addInstance();
    Button1.$name = "CONFIG_BUTTON_0";
    Button1.$hardware = system.deviceData.board.components["BTN-1"];
    Button2.$name = "CONFIG_BUTTON_1";
    Button2.$hardware = system.deviceData.board.components["BTN-2"];
}

/* ======== LEDs (conditional) ======== */
if (needsLeds)
{
    const GPIO = scripting.addModule("/ti/drivers/GPIO");
    const GPIO2 = GPIO.addInstance();
    GPIO2.$hardware = system.deviceData.board.components.LED_GREEN;
    GPIO2.$name = "CONFIG_GPIO_LED_GREEN";
    const GPIO3 = GPIO.addInstance();
    GPIO3.$hardware = system.deviceData.board.components.LED_RED;
    GPIO3.$name = "CONFIG_GPIO_LED_RED";
}

/* ======== OAD (CC23xx) ======== */
/* OAD needs to be added after Bond NVS so Bond NVS handle will remain '0' */
if(needsOad && !(lpName.match(/CC27\d\d/)))
{
    /* Persistent is enabled differently, as it is relevant only within the persistent example. */
    if (oadMethod == "OAD_APP_PERSISTENT")
    {
        ble.enableOad = true;
        ble.enablePersistentOad = true;
        ble.mcubootSignVersion1 = "0.0.1";
        ble.oadMethod = "NONE";
    }
    else if (oadMethod == "MULTISTEP_OAD")
    {
        /* For multistep-oad, we need to specifically inset the oadMethod as this string is used
           by the prebuild script in order to inject the halfModeBuild to the sysconfig file */
        ble.enableOad = true;
        ble.oadMethod = "MULTISTEP_OAD";
    }
    else
    {
        ble.enableOad = true;
        ble.oadMethod = oadMethod;
    }
}
